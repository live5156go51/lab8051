	;50H~57H ;;闹钟显示缓冲区
	;60H~67H ;;数字钟显示缓冲区	
	DELAY20 EQU 70H	;use in INTT0 (delay)function
	CNT71H	EQU	71H	;control delay
	CNT72H	EQU	72H	;control delay
	CNT73H	EQU 73H ;control buzzer 时间
	ORG 0000H
	AJMP MAIN
	ORG 0003H
	AJMP INTER0 ;; INT0
	ORG 000BH
	AJMP INTT0	;; Timer0
	ORG 0030H
MAIN:
	SETB EA
	SETB ET0
	SETB TR0
	SETB EX0
	SETB IT0
	CLR PX0  ;; IP 优先级
	SETB PT0	
	MOV TMOD,#01H
	MOV TL0,#0AEH
	MOV TH0,#3CH
	
	MOV 60H,#00H
	MOV 61H,#00H
	MOV 62H,#00H
	MOV 63H,#00H
	MOV 64H,#00H
	MOV 65H,#01H
	MOV 66H,#00H
	MOV 67H,#00H
	CLR P3.5
	MOV P1,#00H
	MOV DELAY20,#20 ; delay	
LOOP:
	ACALL DISPLAY
	ACALL CHTIME
	SJMP LOOP
	
CHTIME:  ;;判断时间是否和闹钟设置的一样
	MOV A,65H
	CJNE A,55H,NEXHHH
	MOV A,64H
	CJNE A,54H,NEXHHH
	MOV A,63H
	CJNE A,53H,NEXHHH
	MOV A,62H
	CJNE A,52H,NEXHHH
;;;;闹钟	
	SETB P3.5
	
NEXHHH:
	JB P3.0,KEY3
	ACALL DISPLAY
	ACALL DISPLAY
	JB P3.0,KEY3
	ACALL MINKEY
KEY3:
	JB P3.1,CHTIMERET
	ACALL DISPLAY
	ACALL DISPLAY
	JB P3.1,CHTIMERET
	ACALL HOURKEY
CHTIMERET:
	RET
	
DISPLAY:
	MOV R3,#8
	MOV R0,#67H
	MOV R4,#80H
	MOV DPTR,#TAB
LOOP1:
	MOV A,@R0
	MOVC A,@A+DPTR
	MOV P2,A
	MOV P1,R4
	
	MOV A,R4
	RR A
	MOV R4,A
	
	ACALL DELAY
	MOV P1,#00H
	DEC R0
	DJNZ R3,LOOP1
	RET
	
CONLED:
	INC 67H
	MOV A,67H
	CJNE A,#10,EXRET
	MOV 67H,#00H
	
	INC 66H
	MOV A,66H
	CJNE A,#6,EXRET
	CLR P3.5 ;闹钟响一分钟
	MOV 66H,#00H
MINKEY:	;当按键按下，调分钟
	INC 65H
	MOV A,65H
	
	CJNE A,#10,EXRET
	MOV 65H,#00H
	
	INC 64H
	MOV A,64H
	CJNE A,#6,EXRET
	MOV 64H,#00H
	
HOURKEY:   ;当按键按下，调小时
	INC 63H
	MOV A,63H
	
	CJNE A,#4,CONE0 ;判断是否等于24 小时的 4 ,
	MOV A,62H
	CJNE A,#2,CONE0 ;如果60H等于2且61H等于4，则顺序执行复位
	SJMP HOURS24
	
CONE0:
	MOV A,63H
	CJNE A,#10,EXRET
	MOV 63H,#00H
	
	INC 62H
	MOV A,62H
	SJMP EXRET
HOURS24:  ;24 hours Reset Label HOURKE~HOURS24 为处理24小时进位问题 	
	MOV 62H,#00H
	MOV 63H,#00H
	
	INC 61H
	MOV A,61H
	CJNE A,#10,EXRET
	
	INC 60H
	MOV A,60H
	CJNE A,#10,EXRET
	; 99 day Reset
	MOV 60H,#00H
	MOV 61H,#00H
EXRET:
	RET
;;;End CONLED (MINKEY) (HOURKEY)
;;;timer0	
INTT0:
	MOV TL0,#0AEH
	MOV TH0,#3CH
	DJNZ DELAY20,EXITT0
	MOV DELAY20,#20	
	ACALL CONLED	
EXITT0:
	RETI
;;;End timer0
;;;interrupt0
INTER0:
	CLR EX0 ;;关中断 复用中断按键
	CLR IT0
	CLR P3.5 ;关闹钟
	PUSH 00H
	PUSH 03H
	PUSH 04H
	PUSH ACC
MAIN2:
	ACALL DISPLAY2
	JB P3.2,KEYP311
	ACALL DISPLAY2
	ACALL DISPLAY2
	JB P3.2,EXITER0  ;退出闹铃设置
KEYP311:
	JB P3.0,KEYP322
	ACALL DISPLAY2
	ACALL DISPLAY2
	JB P3.0,KEYP322
	ACALL MINKEY2 ;;调分钟
KEYP322:
	JB P3.1,MAIN2
	ACALL DISPLAY2
	ACALL DISPLAY2
	JB P3.1,MAIN2
	ACALL HOURKEY2;;调小时
	SJMP MAIN2	
	
EXITER0:
	POP ACC
	POP 04H
	POP 03H
	POP 00H
	SETB EX0
	SETB IT0
	RETI
;; END interrrupt0	
MINKEY2:	;闹钟分钟设置	
	INC 55H
	MOV A,55H
	CJNE A,#10,EXITT2
	MOV 55H,#00H
	
	INC 54H
	MOV A,54H
	CJNE A,#6,EXITT2
	MOV 54H,#00H
	
HOURKEY2:	;闹钟时间设置
	INC 53H
	MOV A,53H
	
	CJNE A,#4,CONE01
	MOV A,52H
	CJNE A,#2,CONE01
	MOV 53H,#00H
	MOV 52H,#00H	
	SJMP EXITT2
CONE01:
	MOV A,53H
	CJNE A,#10,EXITT2
	MOV 53H,#00H
	
	INC 52H
	MOV A,52H
EXITT2:
	RET
	
DISPLAY2:  ;;设置闹钟显示缓冲区
	MOV R3,#8
	MOV R0,#57H
	MOV R4,#80H
	MOV DPTR,#TAB
LOOP2:
	MOV A,@R0
	MOVC A,@A+DPTR
	MOV P2,A
	MOV P1,R4
	
	MOV A,R4
	RR A
	MOV R4,A
	
	ACALL DELAY
	MOV P1,#00H
	DEC R0
	DJNZ R3,LOOP2
	RET
;;; End DISPLAY2
DELAY: ; delay(1ms)
	MOV CNT71H,#7 ; 7*8 = 56ms
DL0:	
	MOV CNT72H,#0FAH ; 250*4 
DL1:
	NOP
	NOP
	DJNZ CNT72H,DL1
	DJNZ CNT71H,DL0
	RET
	
TAB:
	DB      0C0H, 0F9H, 0A4H, 0B0H  ;0, 1, 2, 3
	DB       99H,  92H,  82H, 0F8H  ;4, 5, 6, 7
	DB       80H,  90H				;8, 9
	END